/** \file
  \brief Test prints generated by the firmware, see calibration.h.

  The moves go through the same path as G1 (bed leveling included), E
  relative, like the firmware retract: the E coordinate of the host is
  restored after each move, so a print continues afterwards as if nothing
  happened. M410 stops a test print.
*/

#include "calibration.h"

#include <math.h>
#include <string.h>

#include "dda.h"
#include "dda_queue.h"
#include "clock.h"
#include "gcode_parse.h"
#include "home.h"
#include "serial.h"
#include "sersendf.h"
#include "settings.h"
#include "bed_leveling.h"
#include "emergency_parser.h"
#include "temp.h"
#include "input_shaping.h"

#ifdef CAL_PATTERNS

/// Travel, retract, first layer speeds, mm/min.
#define CAL_TRAVEL_F     6000
#define CAL_RETRACT_F    1800
#define CAL_PRINT_F      1200
/// Retract length, lift for travel moves, um.
#define CAL_RETRACT      1000
#define CAL_LIFT         1000

static uint8_t cal_qs;            ///< Quickstop counter at the start.
static uint8_t cal_ok;            ///< 0 after a quickstop.
static int32_t cal_x, cal_y, cal_z;  ///< Current position, um.
static float cal_e_per_mm;        ///< Filament um per path um.
static uint8_t cal_retracted;

/// Bed center, um.
static int32_t center(enum axis_e a) {
  if (a == X)
    return (int32_t)((X_MIN + X_MAX) * 500.) + home_offset[X];
  return (int32_t)((Y_MIN + Y_MAX) * 500.) + home_offset[Y];
}

/// Checks before a test print. \return 1 if it can start.
static uint8_t cal_begin(const cal_line_t *line) {
  float dia = (float)settings.filament_dia * 0.001f;

  if ((axes_homed & HOMED_XYZ) != HOMED_XYZ) {
    serial_writestr("echo:Home X, Y and Z first (G28)\n");
    return 0;
  }
  queue_wait();
  cal_qs = emergency_quickstop_count();
  cal_ok = 1;
  cal_retracted = 0;
  cal_x = startpoint.axis[X];
  cal_y = startpoint.axis[Y];
  cal_z = startpoint.axis[Z];
  // Filament per path length: layer * width / filament cross section.
  cal_e_per_mm = (float)line->layer * 0.001f * (float)line->width * 0.001f /
                 (0.7853982f * dia * dia);
  return 1;
}

/// Queue one move to x, y, z with de um of filament. Keeps the host E.
static void cal_move(int32_t x, int32_t y, int32_t z, int32_t de,
                     uint32_t feed) {
  TARGET t = startpoint;
  TARGET saved = startpoint;

  if ( ! cal_ok)
    return;
  t.axis[X] = x;
  t.axis[Y] = y;
  t.axis[Z] = z;
  t.axis[E] = de;
  t.e_relative = 1;
  t.e_multiplier = 256;
  t.f_multiplier = 256;
  t.F = feed;
  bed_level_enqueue(&t);
  startpoint.axis[E] = saved.axis[E];
  startpoint.e_relative = saved.e_relative;
  startpoint.F = saved.F;
  cal_x = x;
  cal_y = y;
  cal_z = z;
  if (emergency_quickstop_count() != cal_qs)
    cal_ok = 0;
}

static void cal_retract(void) {
  if ( ! cal_retracted)
    cal_move(cal_x, cal_y, cal_z, -CAL_RETRACT, CAL_RETRACT_F);
  cal_retracted = 1;
}

static void cal_unretract(void) {
  if (cal_retracted)
    cal_move(cal_x, cal_y, cal_z, CAL_RETRACT, CAL_RETRACT_F);
  cal_retracted = 0;
}

/// Travel to x, y at layer height z: retract, lift, move, lower, prime.
static void cal_travel(int32_t x, int32_t y, int32_t z) {
  cal_retract();
  cal_move(cal_x, cal_y, cal_z + CAL_LIFT, 0, CAL_TRAVEL_F);
  cal_move(x, y, z + CAL_LIFT, 0, CAL_TRAVEL_F);
  cal_move(x, y, z, 0, CAL_TRAVEL_F);
  cal_unretract();
}

/// Extruding line to x, y at the current height.
static void cal_line(int32_t x, int32_t y, uint32_t feed) {
  float dx = (float)(x - cal_x), dy = (float)(y - cal_y);
  float len = sqrtf(dx * dx + dy * dy);

  cal_move(x, y, cal_z, (int32_t)(len * cal_e_per_mm + 0.5f), feed);
}

/// End of a test print: retract, 10 mm up.
static void cal_finish(void) {
  uint8_t ok = cal_ok;

  cal_ok = 1;
  if (emergency_quickstop_count() == cal_qs) {
    cal_retract();
    cal_move(cal_x, cal_y, cal_z + 10000, 0, CAL_TRAVEL_F);
  }
  queue_wait();
  if ( ! ok)
    serial_writestr("echo:Test print stopped\n");
}

/// Hotend must be hot for patterns without their own heating.
static uint8_t hotend_ready(void) {
  #ifdef HEATER_EXTRUDER
    if (temp_get_target(TEMP_SENSOR_extruder) == 0) {
      serial_writestr("echo:Heat the hotend first (M109)\n");
      return 0;
    }
    temp_wait_sensor(TEMP_SENSOR_extruder, 1);
  #endif
  return 1;
}

/// Prime line along X at y, length 60 mm, double flow.
static void cal_prime_line(int32_t x, int32_t y, int32_t z) {
  float e = cal_e_per_mm;

  cal_travel(x, y, z);
  cal_e_per_mm = 2.f * e;
  cal_line(x + 60000, y, CAL_PRINT_F);
  cal_e_per_mm = e;
}

#ifdef BED_LEVELING
void cal_g26(uint16_t hotend, uint16_t bed, const cal_line_t *line,
             int32_t prime_um, uint8_t keep) {
  uint8_t ix, iy, k, was_active;
  int32_t r, x, y, z = line->layer;

  if ( ! mesh.nx) {
    serial_writestr("echo:No mesh (G29 or M421 first)\n");
    return;
  }
  if ( ! cal_begin(line))
    return;
  #ifdef HEATER_BED
    if (bed) {
      temp_set(TEMP_SENSOR_bed, bed * 4);
      temp_wait_sensor(TEMP_SENSOR_bed, 1);
    }
  #else
    (void)bed;
  #endif
  #ifdef HEATER_EXTRUDER
    if (hotend) {
      temp_set(TEMP_SENSOR_extruder, hotend * 4);
      temp_wait_sensor(TEMP_SENSOR_extruder, 1);
    }
  #else
    (void)hotend;
  #endif
  if ( ! hotend_ready())
    return;
  was_active = bed_level_active();
  bed_level_set_active(1);

  // Circles of a sixth of the grid spacing, 2..6 mm.
  r = (mesh.dx < mesh.dy ? mesh.dx : mesh.dy) / 6;
  if (r < 2000) r = 2000;
  if (r > 6000) r = 6000;

  // Prime: a blob in front of the first point, then a line.
  cal_travel(mesh.x0 - 2 * r, mesh.y0 - 2 * r, z);
  cal_move(cal_x, cal_y, cal_z, prime_um, 120);
  cal_line(mesh.x0 + mesh.dx * (mesh.nx - 1), mesh.y0 - 2 * r, CAL_PRINT_F);

  sersendf_P(("echo:G26: %sux%su circles\n"), mesh.nx, mesh.ny);
  // Circles, row by row, serpentine.
  for (iy = 0; iy < mesh.ny && cal_ok; iy++) {
    for (k = 0; k < mesh.nx && cal_ok; k++) {
      ix = (iy & 1) ? (uint8_t)(mesh.nx - 1 - k) : k;
      x = mesh.x0 + mesh.dx * ix;
      y = mesh.y0 + mesh.dy * iy;
      cal_travel(x + r, y, z);
      {
        uint8_t s;

        for (s = 1; s <= 24; s++) {
          float a = 6.2831853f * (float)s / 24.f;

          cal_line(x + (int32_t)lrintf((float)r * cosf(a)),
                   y + (int32_t)lrintf((float)r * sinf(a)), CAL_PRINT_F);
        }
      }
    }
  }
  // Lines between the circles: rows, then columns.
  for (iy = 0; iy < mesh.ny && cal_ok; iy++)
    for (ix = 0; ix + 1 < mesh.nx && cal_ok; ix++) {
      y = mesh.y0 + mesh.dy * iy;
      cal_travel(mesh.x0 + mesh.dx * ix + r, y, z);
      cal_line(mesh.x0 + mesh.dx * (ix + 1) - r, y, CAL_PRINT_F);
    }
  for (ix = 0; ix < mesh.nx && cal_ok; ix++)
    for (iy = 0; iy + 1 < mesh.ny && cal_ok; iy++) {
      x = mesh.x0 + mesh.dx * ix;
      cal_travel(x, mesh.y0 + mesh.dy * iy + r, z);
      cal_line(x, mesh.y0 + mesh.dy * (iy + 1) - r, CAL_PRINT_F);
    }
  cal_finish();
  if ( ! was_active)
    bed_level_set_active(0);
  if ( ! keep) {
    #ifdef HEATER_EXTRUDER
      temp_set(TEMP_SENSOR_extruder, 0);
    #endif
    #ifdef HEATER_BED
      temp_set(TEMP_SENSOR_bed, 0);
    #endif
  }
  serial_writestr("echo:G26 done\n");
}
#endif /* BED_LEVELING */

#ifdef LINEAR_ADVANCE
void cal_la_pattern(int32_t k0, int32_t k1, int32_t kstep, uint32_t slow,
                    uint32_t fast, const cal_line_t *line) {
  uint32_t saved_k = settings.la_k;
  int32_t n, i, x0, y0, z = line->layer;

  if (kstep <= 0 || k1 < k0 || k0 < 0 || k1 > 100000L) {
    serial_writestr("echo:M9910: bad K range\n");
    return;
  }
  n = (k1 - k0) / kstep + 1;
  if (n > 30) {
    serial_writestr("echo:M9910: at most 30 lines\n");
    return;
  }
  if ( ! cal_begin(line) || ! hotend_ready())
    return;

  x0 = center(X) - 40000;
  y0 = center(Y) - n * 2500;
  cal_prime_line(x0 + 10000, y0 - 10000, z);
  for (i = 0; i < n && cal_ok; i++) {
    int32_t k = k0 + i * kstep, y = y0 + i * 5000;

    queue_wait();                         // Queued moves keep their K.
    settings.la_k = (uint32_t)k;
    sersendf_P(("echo:LA pattern line %lu: K%lu.%04lu\n"), (uint32_t)(i + 1),
               (uint32_t)k / 10000, (uint32_t)k % 10000);
    cal_travel(x0, y, z);
    cal_line(x0 + 20000, y, slow);
    cal_line(x0 + 60000, y, fast);
    cal_line(x0 + 80000, y, slow);
  }
  cal_finish();
  settings.la_k = saved_k;
  serial_writestr("echo:LA pattern done, lines from the front\n");
}
#endif /* LINEAR_ADVANCE */

#ifdef INPUT_SHAPING
void cal_is_tower(uint32_t f0, uint32_t f1, int32_t height, uint32_t speed,
                  const cal_line_t *line) {
  uint32_t saved_f[2];
  int32_t side = 50000, x0, y0, z, layers, i, last_report = -1;

  if (height < line->layer || height > 200000L) {
    serial_writestr("echo:M9911: bad height\n");
    return;
  }
  if ( ! cal_begin(line) || ! hotend_ready())
    return;
  saved_f[0] = settings.is_freq[0];
  saved_f[1] = settings.is_freq[1];
  x0 = center(X) - side / 2;
  y0 = center(Y) - side / 2;
  layers = height / line->layer;

  cal_prime_line(x0, y0 - 10000, line->layer);
  cal_travel(x0, y0, line->layer);
  for (i = 0; i < layers && cal_ok; i++) {
    uint32_t f = f0 + (uint32_t)((int64_t)((int32_t)f1 - (int32_t)f0) * i /
                                 (layers > 1 ? layers - 1 : 1));
    uint32_t feed = i ? speed : CAL_PRINT_F;

    z = line->layer * (i + 1);
    // New frequency for this layer, the queue has to be empty for it.
    queue_wait();
    settings.is_freq[0] = settings.is_freq[1] = f;
    shaper_configure();
    if (z / 5000 != last_report) {
      last_report = z / 5000;
      sersendf_P(("echo:IS tower Z%lq F%lu.%02lu\n"), z, f / 100, f % 100);
    }
    cal_move(x0, y0, z, 0, CAL_TRAVEL_F);
    cal_line(x0 + side, y0, feed);
    cal_line(x0 + side, y0 + side, feed);
    cal_line(x0, y0 + side, feed);
    cal_line(x0, y0, feed);
  }
  cal_finish();
  settings.is_freq[0] = saved_f[0];
  settings.is_freq[1] = saved_f[1];
  shaper_configure();
  serial_writestr("echo:IS tower done\n");
}
#endif /* INPUT_SHAPING */

#endif /* CAL_PATTERNS */

static uint8_t tower_param;
static float tower_start, tower_factor;
static int32_t tower_band, tower_last_z = INT32_MIN;

void tower_set(uint8_t param, float start, float factor, int32_t band_um) {
  tower_param = (param < TOWER_PARAMS) ? param : TOWER_OFF;
  tower_start = start;
  tower_factor = factor;
  tower_band = band_um > 0 ? band_um : 0;
  tower_last_z = INT32_MIN;
}

void tower_report(void) {
  if (tower_param == TOWER_OFF) {
    serial_writestr("echo:Tuning tower off\n");
    return;
  }
  sersendf_P(("echo:Tuning tower P%su A%ld B%ld C%lq (A, B in 1/1000)\n"),
             tower_param, (int32_t)lrintf(tower_start * 1000.f),
             (int32_t)lrintf(tower_factor * 1000.f), tower_band);
}

void tower_z(int32_t z_um) {
  float z, v;
  int32_t zq = z_um;

  if (tower_param == TOWER_OFF)
    return;
  if (tower_band) {
    zq = (z_um / tower_band) * tower_band + tower_band / 2;
    if (z_um < 0)
      zq -= tower_band;
  }
  if (zq == tower_last_z)
    return;
  tower_last_z = zq;
  z = (float)zq * 0.001f;
  v = tower_start + tower_factor * z;
  if (v < 0.f)
    v = 0.f;

  switch (tower_param) {
    #ifdef LINEAR_ADVANCE
    case TOWER_LA_K:
      if (v > 10.f) v = 10.f;
      settings.la_k = (uint32_t)lrintf(v * 10000.f);
      break;
    #endif
    #ifdef INPUT_SHAPING
    case TOWER_IS_FREQ:
      if (v > 500.f) v = 500.f;
      queue_wait();
      settings.is_freq[0] = settings.is_freq[1] = (uint32_t)lrintf(v * 100.f);
      shaper_configure();
      break;
    #endif
    case TOWER_JD:
      if (v > 1.f) v = 1.f;
      settings.junction_dev = (uint32_t)lrintf(v * 1000.f);
      break;
    #ifdef HEATER_EXTRUDER
    case TOWER_HOTEND:
      temp_set(TEMP_SENSOR_extruder, (uint16_t)lrintf(v * 4.f));
      break;
    #endif
    case TOWER_FLOW:
      next_target.target.e_multiplier = (uint16_t)lrintf(v * 2.56f);
      break;
    case TOWER_ACCEL:
      if (v < 1.f) v = 1.f;
      settings.acceleration = (uint32_t)lrintf(v);
      break;
    default:
      return;
  }
  sersendf_P(("echo:Tuning tower Z%lq: %ld/1000\n"), zq,
             (int32_t)lrintf(v * 1000.f));
}
