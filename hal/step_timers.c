/** \file
  \brief STEP pulses generated by timers (STEP_TIMER_PULSES).

  Each axis group (X, Y, Z with Z2, E) whose STEP pin is a timer channel
  output gets a timer in one pulse mode:

    PWM mode 2, CCR = 1, ARR = pulse width: after a start (one register
    write, CR1 = OPM | CEN) the output goes active one cycle later, stays
    active until the counter reaches ARR, then the timer stops and the
    output goes inactive again.

  So the step interrupt only writes one register per axis, the pulse end
  needs neither waiting nor the pulse end interrupt.

  An axis group falls back to GPIO pulses (reported at startup) if its pin
  has no timer channel, the timer is TIM5 (step timing), a heater uses the
  timer for PWM, another axis group uses it already, or Z and Z2 are on
  different timers. Pins on the same timer as another group would get
  pulses at the other group's steps, too.

  Not used with ACCELERATION_TEMPORAL.
*/

#include <stddef.h>
#include "pinio.h"
#include "heater.h"
#include "serial.h"

#if defined STEP_TIMER_PULSES && ! defined ACCELERATION_TEMPORAL

TIM_TypeDef *step_timer[4];

typedef struct {
  uint32_t timer;
  uint8_t channel, af, complementary, id;
} step_pin_t;

#define STEP_PIN_INFO(p) \
  { (uint32_t)PIN_TIMER(p), PIN_CHANNEL(p), PIN_AF(p), PIN_COMPL(p), PIN_ID(p) }

/// Configure one channel: PWM mode 2, compare 1, output enabled.
static void setup_channel(TIM_TypeDef *tim, const step_pin_t *pin) {
  uint32_t shift = ((pin->channel - 1) & 1) * 8;
  volatile uint32_t *ccmr = (pin->channel <= 2) ? &tim->CCMR1 : &tim->CCMR2;
  uint32_t ccer_shift = (pin->channel - 1) * 4;
  GPIO_TypeDef *port = PIN_ID_PORT(pin->id);
  uint32_t n = PIN_ID_NUM(pin->id);

  *ccmr = (*ccmr & ~(0xFFUL << shift)) |
          ((TIM_CCMR1_OC1M_2 | TIM_CCMR1_OC1M_1 | TIM_CCMR1_OC1M_0) << shift);
  (&tim->CCR1)[pin->channel - 1] = 1;
  tim->CCER = (tim->CCER & ~(0xFUL << ccer_shift)) |
              ((pin->complementary ? TIM_CCER_CC1NE : TIM_CCER_CC1E) << ccer_shift);

  gpio_af(port, n, pin->af);
  gpio_speed(port, n, GPIO_SPEED_HIGH);
  gpio_mode(port, n, GPIO_MODE_AF);
}

/// Try to use a timer for an axis group of one or two pins.
static TIM_TypeDef *setup_group(const step_pin_t *p1, const step_pin_t *p2,
                                uint8_t group) {
  TIM_TypeDef *tim;
  uint8_t g;

  if (p1->timer == TIMER_NONE || p1->timer == TIM5_BASE)
    return NULL;
  if (p2 && p2->timer != p1->timer)
    return NULL;
  if (heater_uses_timer(p1->timer))
    return NULL;
  for (g = 0; g < group; g++)
    if (step_timer[g] && (uint32_t)step_timer[g] == p1->timer)
      return NULL;

  tim = (TIM_TypeDef *)p1->timer;
  timer_clock_on(p1->timer);
  tim->CR1 = TIM_CR1_OPM;
  tim->PSC = 0;
  tim->ARR = STEP_PULSE_CYCLES;               // Pulse width + 1 cycle delay.
  tim->CNT = 0;
  setup_channel(tim, p1);
  if (p2)
    setup_channel(tim, p2);
  if (p1->timer == TIM1_BASE)
    tim->BDTR |= TIM_BDTR_MOE;
  tim->EGR = TIM_EGR_UG;                      // Load ARR, CNT = 0.
  tim->SR = 0;
  return tim;
}

void step_timers_init(void) {
  static const char *const name[4] = { " X ", " Y ", " Z ", " E " };
  const step_pin_t x = STEP_PIN_INFO(X_STEP_PIN);
  const step_pin_t y = STEP_PIN_INFO(Y_STEP_PIN);
  uint8_t g;

  step_timer[0] = setup_group(&x, NULL, 0);
  step_timer[1] = setup_group(&y, NULL, 1);
  #if defined Z_STEP_PIN && defined Z_DIR_PIN
  {
    const step_pin_t z = STEP_PIN_INFO(Z_STEP_PIN);
    #if defined Z2_STEP_PIN && defined Z2_DIR_PIN
      const step_pin_t z2 = STEP_PIN_INFO(Z2_STEP_PIN);
      step_timer[2] = setup_group(&z, &z2, 2);
    #else
      step_timer[2] = setup_group(&z, NULL, 2);
    #endif
  }
  #endif
  #if defined E_STEP_PIN && defined E_DIR_PIN
  {
    const step_pin_t e = STEP_PIN_INFO(E_STEP_PIN);
    step_timer[3] = setup_group(&e, NULL, 3);
  }
  #endif

  serial_writestr("echo:Step pulses:");
  for (g = 0; g < 4; g++) {
    static const uint32_t bases[] = { TIM1_BASE, TIM2_BASE, TIM3_BASE,
                                      TIM4_BASE, TIM9_BASE, TIM10_BASE,
                                      TIM11_BASE };
    static const char *const tname[] = { "TIM1", "TIM2", "TIM3", "TIM4",
                                         "TIM9", "TIM10", "TIM11" };
    uint8_t k;

    serial_writestr(name[g]);
    if ( ! step_timer[g]) {
      serial_writestr("gpio");
      continue;
    }
    for (k = 0; k < 7; k++)
      if ((uint32_t)step_timer[g] == bases[k])
        serial_writestr(tname[k]);
  }
  serial_writechar('\n');
}

#else

void step_timers_init(void) {
}

#endif
